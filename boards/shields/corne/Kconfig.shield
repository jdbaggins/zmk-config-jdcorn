## boards/shields/corne/Kconfig.shield
```kconfig
config SHIELD_JDCORNE_LEFT
    def_bool $(shields_list_contains,jdcorne_left)

config SHIELD_JDCORNE_RIGHT
    def_bool $(shields_list_contains,jdcorne_right)
```

## boards/shields/corne/kconfig.defconfig
```kconfig
if SHIELD_JDCORNE_LEFT

config ZMK_KEYBOARD_NAME
    default "jdcorne"

config ZMK_SPLIT_ROLE_CENTRAL
    default y

endif

if SHIELD_JDCORNE_LEFT || SHIELD_JDCORNE_RIGHT

config ZMK_SPLIT
    default y

endif
```
